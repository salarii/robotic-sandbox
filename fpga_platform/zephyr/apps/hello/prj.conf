## CMakeLists.txt
```
cmake_minimum_required(VERSION 3.20.0)

# Locates Zephyr using the ZEPHYR_BASE environment variable
find_package(Zephyr REQUIRED HINTS $ENV{ZEPHYR_BASE})
project(hello_world_local)

target_sources(app PRIVATE src/main.c)
```

## prj.conf
```kconfig
CONFIG_SERIAL=y
CONFIG_UART_CONSOLE=y
CONFIG_CONSOLE=y
CONFIG_PRINTK=y
CONFIG_SYS_CLOCK_EXISTS=y
CONFIG_RISCV_MACHINE_TIMER=y
CONFIG_RISCV_GP=n
CONFIG_SYS_CLOCK_HW_CYCLES_PER_SEC=25000000
```

## src/main.c
```c
#include <zephyr/kernel.h>
#include <zephyr/sys/printk.h>

int main(void)
{
    int count = 0;

    printk("\n=========================================\n");
    printk(" Zephyr RTOS running on VexRiscv RTL!     \n");
    printk("=========================================\n\n");

    while (1) {
        printk("Tick count: %d\n", count++);
        k_msleep(1000);
    }

    return 0;
}
```
