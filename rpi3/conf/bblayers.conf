## rpi3/conf/local.conf
```bitbake
MACHINE = "raspberrypi3"
DISTRO = "poky"
PACKAGE_CLASSES = "package_rpm"
EXTRA_IMAGE_FEATURES ?= "debug-tweaks"
USER_CLASSES ?= "buildstats"
PATCHRESOLVE = "noop"
BB_DISKMON_DIRS ??= "\
    STOPTASKS,${TMPDIR},1K,100K \
    STOPTASKS,${DL_DIR},1K,100K \
    STOPTASKS,${SSTATE_DIR},1K,100K \
    STOPTASKS,/tmp,1K,100K \
    ABORT,${TMPDIR},100K,1K \
    ABORT,${DL_DIR},100K,1K \
    ABORT,${SSTATE_DIR},100K,1K \
    ABORT,/tmp,100K,1K"
PACKAGECONFIG:append:pn-qemu-system-native = " sdl"
CONF_VERSION = "2"

# Free up disk space after building packages
INHERIT += "rm_work"
ENABLE_UART = "1"
SERIAL_CONSOLES = "115200;ttyAMA0 115200;ttyS0"
RPI_EXTRA_CONFIG = "dtoverlay=miniuart-bt"
```
